## boards/shields/avalanche/Kconfig.shield
```kconfig
config SHIELD_AVALANCHE_LEFT
	def_bool $(shields_list_contains,avalanche_left)

config SHIELD_AVALANCHE_RIGHT
	def_bool $(shields_list_contains,avalanche_right)
```
